## west.yml
```yaml
# Copyright (c) 2024 Nordic Semiconductor ASA
# SPDX-License-Identifier: Apache-2.0

manifest:
  remotes:
    - name: ncs
      url-base: https://github.com/nrfconnect
    - name: fork_nrf
      url-base: https://github.com/TonyHuangtohu/

  projects:
    - name: nrf
      remote: fork_nrf
      repo-path: sdk-nrf/tree/haiman_zigbee_matter
      revision: 70f7c390cb15c880db984bea033dc454ff1efbea
      import: true
```
